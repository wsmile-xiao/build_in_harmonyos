## archives/k/kconfig-frontends/4.11.0.1/test_package/fixtures/Kconfig
```kconfig
mainmenu "kconfig-frontends Conan consumer test"

config ENABLE_PARSER
	bool "Enable parser API test"
	default y

config DEFAULT_COUNT
	int "Default integer"
	range 0 10
	default 7

choice
	prompt "Default choice"
	default DEFAULT_CHOICE_A

config DEFAULT_CHOICE_A
	bool "Choice A"

config DEFAULT_CHOICE_B
	bool "Choice B"

endchoice

config DEFAULT_TEXT
	string "Default text"
	default "HarmonyOS"
```
